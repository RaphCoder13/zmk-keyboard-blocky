/*
 * Copyright (c) 2022 The ZMK Contributors
 *
 * SPDX-License-Identifier: MIT
 */

#include "blocky.dtsi"
&kscan0 {
    col-gpios
        = <&xiao_d 0 GPIO_ACTIVE_HIGH>
        , <&xiao_d 1 GPIO_ACTIVE_HIGH>
        , <&xiao_d 2 GPIO_ACTIVE_HIGH>
        , <&xiao_d 3 GPIO_ACTIVE_HIGH>
        , <&xiao_d 6 GPIO_ACTIVE_HIGH>
        ;
};

// /{
//     trackpoint_listener: trackpoint_listener {
//         compatible = "zmk,input-listener";

//         status = "disabled";
//         // input-processors = <&zip_xy_transform (INPUT_TRANSFORM_XY_SWAP)>;
//     };

// };