## boards/shields/blocky/Kconfig.defconfig
```kconfig
# Copyright (c) 2022 The ZMK Contributors
# SPDX-License-Identifier: MIT

if SHIELD_BLOCKY_DONGLE


config ZMK_KEYBOARD_NAME
    default "blocky"

config ZMK_SPLIT_ROLE_CENTRAL
    default y

config ZMK_SPLIT_BLE_CENTRAL_PERIPHERALS
    default 2

config BT_MAX_CONN
    default 6

config BT_MAX_PAIRED
    default 6

config ZMK_POINTING
    default y
endif


if SHIELD_BLOCKY_RIGHT

# enable pointing device
config ZMK_POINTING
    default y

config NFCT_PINS_AS_GPIOS
    default y
endif



if SHIELD_BLOCKY_LEFT || SHIELD_BLOCKY_RIGHT || SHIELD_BLOCKY_DONGLE

config ZMK_SPLIT
    default y

endif
```

## boards/shields/blocky/Kconfig.shield
```kconfig
# Copyright (c) 2022 The ZMK Contributors
# SPDX-License-Identifier: MIT

config SHIELD_BLOCKY_LEFT
    def_bool $(shields_list_contains,blocky_left)

config SHIELD_BLOCKY_RIGHT
    def_bool $(shields_list_contains,blocky_right)
```

## config/west.yml
```yaml
manifest:
  remotes:
    - name: zmkfirmware
      url-base: https://github.com/zmkfirmware
    # Additional modules containing boards/shields/custom code can be listed here as well
    # See https://docs.zephyrproject.org/3.2.0/develop/west/manifest.html#projects
    - name: badjeff
      url-base: https://github.com/badjeff
  projects:
    - name: zmk
      remote: zmkfirmware
      revision: main
      import: app/west.yml
    - name: kb_zmk_ps2_mouse_trackpoint_driver
      remote: badjeff
      revision: main
  self:
    path: config
```
